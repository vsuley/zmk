## app/boards/arm/e73/Kconfig.board
```kconfig
# E73 board configuration

# SPDX-License-Identifier: MIT

config BOARD_E73
    bool "E73"
    depends on SOC_NRF52840_QIAA
```

## app/boards/shields/petrineko65/Kconfig.shield
```kconfig
# Copyright (c) 2020 The ZMK Contributors
# SPDX-License-Identifier: MIT

config SHIELD_PETRINEKO65
    def_bool $(shields_list_contains,petrineko65)
```
